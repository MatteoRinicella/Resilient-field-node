## firmware/esp32/main/Kconfig.projbuild
```kconfig
menu "Resilient Field Node"

    config RFN_WIFI_SSID
        string "Nome rete Wi-Fi (SSID)"
        default ""

    config RFN_WIFI_PASSWORD
        string "Password rete Wi-Fi"
        default ""

    config RFN_GATEWAY_URL
        string "URL gateway eventi"
        default "https://mrculino.eu.pythonanywhere.com/events"

    config RFN_GATEWAY_STATE_URL
        string "URL gateway stato corrente"
        default "https://mrculino.eu.pythonanywhere.com/state"

    config RFN_GATEWAY_API_TOKEN
        string "Token API gateway"
        default ""

endmenu
```
